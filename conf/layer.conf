## conf/layer.conf
```bitbake
# We have a conf and classes directory, add to BBPATH
BBPATH .= ":${LAYERDIR}"

# We have recipes-* directories, add to BBFILES
BBFILES += "${LAYERDIR}/recipes-*/*/*.bb \
            ${LAYERDIR}/recipes-*/*/*.bbappend"

BBFILE_COLLECTIONS += "meta-zoetis-intel-corei7"
BBFILE_PATTERN_meta-zoetis-intel-corei7 := "^${LAYERDIR}/"

# Additional license directories.
#LICENSE_PATH += "${LAYERDIR}/custom-licenses"

LAYERDEPENDS_meta-zoetis-intel-corei7 = "intel"
LAYERRECOMMENDS_meta-zoetis-intel-corei7 = "dpdk intel-qat"

# This should only be incremented on significant changes that will
# cause compatibility issues with other layers
LAYERVERSION_meta-zoetis-intel-corei7 = "6"
LAYERSERIES_COMPAT_meta-zoetis-intel-corei7 = "zeus dunfell"
```
